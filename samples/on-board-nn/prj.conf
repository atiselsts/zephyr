## CMakeLists.txt
```
cmake_minimum_required(VERSION 3.13.1)

include($ENV{ZEPHYR_BASE}/cmake/app/boilerplate.cmake NO_POLICY_SCOPE)
project(on_board_nn)

# set your tensorflow directory from command line, for example by:
# export TENSORFLOW=/home/atis/source/tensorflow
zephyr_include_directories($ENV{TENSORFLOW})
zephyr_include_directories($ENV{TENSORFLOW}/tensorflow/lite/micro/tools/make/downloads/flatbuffers/include)

target_compile_options(app PRIVATE $<$<COMPILE_LANGUAGE:CXX>:-fno-threadsafe-statics -fno-use-cxa-atexit>)

add_library(libtensorflow STATIC IMPORTED GLOBAL)
#set_target_properties(libtensorflow PROPERTIES IMPORTED_LOCATION $ENV{ZEPHYR_BASE}/samples/on-board-nn/libtensorflow-microlite-m3.a)
set_target_properties(libtensorflow PROPERTIES IMPORTED_LOCATION $ENV{ZEPHYR_BASE}/samples/on-board-nn/libtensorflow-microlite-m4.a)
#set_target_properties(libtensorflow PROPERTIES IMPORTED_LOCATION $ENV{ZEPHYR_BASE}/samples/on-board-nn/libtensorflow-microlite-m7.a)
#set_target_properties(libtensorflow PROPERTIES IMPORTED_LOCATION $ENV{ZEPHYR_BASE}/samples/on-board-nn/libtensorflow-microlite-m33.a)
target_link_libraries(app PUBLIC libtensorflow)

target_sources(app PRIVATE src/main.c)
target_sources(app PRIVATE src/raw-data.c)
target_sources(app PRIVATE src/nn.cpp)
```

## prj.conf
```kconfig
CONFIG_FPU=y

CONFIG_CMSIS_DSP=y
CONFIG_CMSIS_DSP_TRANSFORM=y
CONFIG_NEWLIB_LIBC=y

CONFIG_COMPILER_OPT="-DTF_LITE_STATIC_MEMORY -DTF_LITE_MCU_DEBUG_LOG"

CONFIG_MAIN_STACK_SIZE=4096
```

## src/main.c
```c
#include <zephyr.h>
#include <sys/printk.h>
#include <string.h>

#include "nn.h"

#define NUM_TESTS 100

void classify(void)
{
    int64_t start = k_uptime_get();
    int i;
    int dummy = 0;
    for (i = 0; i < NUM_TESTS; ++i) {
        dummy += nn_classify();
    }
    int64_t delta = k_uptime_delta(&start);

    printk("for %u tests: ", NUM_TESTS);
    printk("%lld ms (result=%d)\n", delta, dummy);
}

void main(void)
{
    printk("on board NN speed test running on %s, stack size=%u\n",
            CONFIG_BOARD, CONFIG_MAIN_STACK_SIZE);

    if (nn_setup() >= 0) {
        classify();
    }
}
```

## src/exported-nn.c
```c
/home/atis/work/on-board/cnn/newmodels/nn-custom-128-64-3-8.c
```

## src/nn.cpp
```c
extern "C" {
#include "exported-nn.c"
}

#include "tensorflow/lite/micro/all_ops_resolver.h"
#include "tensorflow/lite/micro/micro_error_reporter.h"
#include "tensorflow/lite/micro/micro_interpreter.h"
#include "tensorflow/lite/schema/schema_generated.h"
#include "tensorflow/lite/version.h"

#include "nn.h"

// Globals, used for compatibility with Arduino-style sketches.
namespace {
tflite::ErrorReporter* error_reporter = nullptr;
const tflite::Model* model = nullptr;
tflite::MicroInterpreter* interpreter = nullptr;
TfLiteTensor* input = nullptr;
TfLiteTensor* output = nullptr;

// Create an area of memory to use for input, output, and intermediate arrays.
// Minimum arena size, at the time of writing. After allocating tensors
// you can retrieve this value by invoking interpreter.arena_used_bytes().
const int kModelArenaSize = 10000;
// Extra headroom for model + alignment + future interpreter changes.
const int kExtraArenaSize = 10000;
const int kTensorArenaSize = kModelArenaSize + kExtraArenaSize;
uint8_t tensor_arena[kTensorArenaSize];
}  // namespace

// The name of this function is important for Arduino compatibility.
void setup() {
  // Set up logging. Google style is to avoid globals or statics because of
  // lifetime uncertainty, but since this has a trivial destructor it's okay.
  // NOLINTNEXTLINE(runtime-global-variables)
  static tflite::MicroErrorReporter micro_error_reporter;
  error_reporter = &micro_error_reporter;

  // Map the model into a usable data structure. This doesn't involve any
  // copying or parsing, it's a very lightweight operation.
  model = tflite::GetModel(MODEL_NAME);
  if (model->version() != TFLITE_SCHEMA_VERSION) {
    TF_LITE_REPORT_ERROR(error_reporter,
                         "Model provided is schema version %d not equal "
                         "to supported version %d.",
                         model->version(), TFLITE_SCHEMA_VERSION);
    return;
  }

  // This pulls in all the operation implementations we need.
  // NOLINTNEXTLINE(runtime-global-variables)
  static tflite::AllOpsResolver resolver;

  // Build an interpreter to run the model with.
  static tflite::MicroInterpreter static_interpreter(
      model, resolver, tensor_arena, kTensorArenaSize, error_reporter);
  interpreter = &static_interpreter;

  // Allocate memory from the tensor_arena for the model's tensors.
  TfLiteStatus allocate_status = interpreter->AllocateTensors();
  if (allocate_status != kTfLiteOk) {
    printf("AllocateTensors() failed\n");
    TF_LITE_REPORT_ERROR(error_reporter, "AllocateTensors() failed");
    return;
  }

  // Obtain pointers to the model's input and output tensors.
  input = interpreter->input(0);
  output = interpreter->output(0);
}

// The name of this function is important for Arduino compatibility.
int loop()
{
  int i;
  for (i = 0; i < 3 * WINDOW_SIZE; ++i) {
    input->data.int8[i] = raw_data[i];
  }

  // Run inference, and report any error
  TfLiteStatus invoke_status = interpreter->Invoke();
  if (invoke_status != kTfLiteOk) {
    TF_LITE_REPORT_ERROR(error_reporter, "Invoke failed\n");
    return -1;
  }

  int best_class = 0;
  for (i = 1; i < NUM_CLASSES; ++i) {
    if (output->data.int8[i] > output->data.int8[best_class]) {
      best_class = i;
    }
  }

  return best_class;
}

extern "C" int nn_setup(void)
{
  setup();
  return 0;
}

extern "C" int nn_classify(void)
{
    return loop();
}
```

## src/nn.h
```c
#ifndef NN_H
#define NN_H

#include <stdint.h>

#ifdef __cplusplus
extern "C" {
#endif  // __cplusplus

int nn_setup(void);
int nn_classify(void);

#ifdef __cplusplus
}  // extern "C"
#endif  // __cplusplus

#define WINDOW_SIZE 256

extern const int8_t raw_data[];

#define NUM_CLASSES 12

// results for 100 tests
#define MODEL_NAME custom_quant_int_128_64_3_8_tflite

/*

The following it time in milliseconds for 100 inferences:

custom_quant_int_128_16_1_12_tflite - 128
custom_quant_int_128_16_1_24_tflite - 96
custom_quant_int_128_16_1_4_tflite  - 352
custom_quant_int_128_16_3_12_tflite - 133
custom_quant_int_128_16_3_24_tflite - 92
custom_quant_int_128_16_3_2_tflite  - 605
custom_quant_int_128_32_1_12_tflite - 218
custom_quant_int_128_32_1_16_tflite - 205
custom_quant_int_128_32_3_1_tflite  - 1926
custom_quant_int_128_32_3_24_tflite - 140
custom_quant_int_128_32_3_8_tflite  - 311
custom_quant_int_128_64_1_12_tflite - 366
custom_quant_int_128_64_1_16_tflite - 352
custom_quant_int_128_64_3_8_tflite  - 548

(Warning - if you compare the numbers with previous emails, know that previously I mostly measured the time of 10 inferences as the models were slower. the paper reports the time of 1 inference, divide the results by 100 to get a value mathching the plots in the paper.)

*/

#endif
```

## src/raw-data.c
```c
#include "nn.h"

const int8_t raw_data[] = {
  8, 12, 119, -2, 118, -22, -6, -104, -112, -73, 1, -83, -82, 44, -49, -4, 75, 78, -61, -47, -13, -91, 102, -126, -75, 16, -128, -91, -49, -59, 93, 111, -26, -30, -9, 107, 8, 40, 84, -121, -80, -49, 75, -43, -120, 96, -59, -43, -26, -91, -73, -118, -70, 69, -74, -2, -74, -121, 101, 20, -29, -67, 29, -15, 62, 69, 10, 66, -46, -12, -41, -58, 43, 38, 44, 17, -97, -68, 102, 90, 100, 79, -11, -70, -110, 64, -45, -107, -35, 112, -30, -6, 89, -57, 25, 122, 115, 70, -118, 101, -65, -79, -62, 122, 125, -128, 101, -11, 66, 16, -117, 100, 61, -11, -14, 20, 48, -21, -97, 107, -107, -77, -6, -109, -68, -119, 115, 123, 23, -32, 4, 24, 74, -96, -20, -2, 76, 78, -17, -106, 38, 71, 1, -103, 4, 30, -114, -104, -58, 118, 107, 6, 67, 9, 89, -31, -20, -100, 97, 15, 93, -78, -81, -21, 116, 65, -37, 112, 89, 12, 40, 2, -86, -114, -9, 33, 58, -35, 30, 77, 6, -33, -92, 70, 83, 51, -22, -116, 110, 66, -39, 126, -79, -109, 118, -64, -102, -70, -28, -89, 95, 86, 105, -91, -56, 59, -125, 70, -18, -102, 108, 100, 45, -119, -52, -92, -3, 66, -102, 33, 85, -20, -95, 77, 56, -40, 42, -40, 59, -8, 106, -87, -38, -96, -64, 115, -53, -10, 4, 87, -98, 86, -44, -74, 7, 16, -7, 97, -4, -60, -10, -86, -26, -22, 71, -96, -61, -90, -126, 48, 77, -55, 36, -23, -75, -42, 64, -82, 4, 104, 43, -83, 31, 75, -22, 29, -84, -113, 118, 44, 50, -82, -73, -48, -19, -15, 80, -19, 65, 72, 4, -46, -72, 118, 110, 89, 117, -35, -30, 78, -31, -18, 33, -77, 68, 66, -100, 97, -85, 101, -85, -92, 67, 12, -73, -14, 69, 34, 33, 61, 33, -107, -32, 88, -7, 125, -46, 57, 81, 110, 83, 78, 76, 118, -59, -103, 100, -23, 51, 85, 46, -42, -5, 52, 85, 66, 111, 107, 98, 8, 112, 106, -89, -67, 65, 125, 96, 31, -16, -56, -120, 19, -23, -52, 74, -93, -63, 124, -97, -2, -41, 40, 70, 27, -8, 57, -64, 117, 17, 64, -110, 20, -53, -50, 43, 19, -66, 104, -35, 28, -1, -55, 48, 123, -78, 32, -2, 123, 67, 69, -113, -96, -36, -57, 76, 54, 97, 29, 82, 6, 100, 112, 37, -105, -35, 46, -99, -24, -51, 107, 112, -104, -1, 28, -101, 6, 26, 6, -82, -30, -62, 51, -35, -73, 33, -87, -27, -122, 28, -31, 71, 86, 114, -94, -18, -11, -6, 2, -86, 88, 56, 85, 45, 54, -123, 53, 20, -36, -28, 75, -68, -35, 24, 40, 72, 45, -51, 116, 115, -67, -22, -11, -100, 25, 47, -86, 38, 101, -102, -52, 85, -68, -101, -126, 42, -98, 27, 118, 60, 40, -106, 41, 20, 52, -12, -82, -25, -125, 53, 21, 64, -2, -47, 95, -98, 7, 19, -27, 83, 65, 93, -18, -10, 119, -120, -87, 68, -39, 29, 123, -115, -16, 62, 10, 117, -63, -79, -115, -81, 79, 2, -11, 43, -11, 5, -67, -124, -57, 78, 112, -81, 88, -16, -2, -7, -45, 13, 123, -80, -19, -56, 108, -46, -47, 72, 127, 34, -70, 56, -106, 80, 126, -114, 58, 39, 29, -95, 19, -111, -18, -35, -34, -113, 17, 18, 43, 89, 20, -78, -14, -62, -49, 91, -26, 40, -104, 101, -103, 67, 72, -57, -98, -86, 21, -23, -101, 33, -7, 6, 121, 35, 70, 125, -35, -107, 113, 69, -49, 79, 85, -106, -40, 91, -49, -107, -23, 56, -113, -81, -35, -103, -61, -23, 112, 124, -25, -20, -78, 54, 96, -62, 125, 19, -118, 110, -29, -100, 127, 25, -18, -40, 21, 114, -76, 56, -127, -14, 49, 71, 123, 41, -113, -37, -74, -103, -57, 49, -96, 19, -16, -79, 9, -25, 72, -61, -26, 4, -57, -53, -68, -84, -107, 71, 13, 96, -93, -98, -54, -98, 108, 33, 60, -14, 77, 72, -107, -43, 113, 89, 54, -86, 28, 108, 8, 110, 2, -50, -5, 116, 18, 22, 96, 106, -55, -10, -16, -28, -82, 8, 123, -63, 101, 66, -22, 109, 2, -90, 2, 95, 92, 80, 35, -125, 81, 14, -75, -98, -103, 12, 111, 125, 34, 67, -67, -42, 17, -71, 64, -115, 32, 52, -58, 119, 6, -35, -91, -40, -15, 12, -58, -61, -109, 119, 111, 82, -101, 4, 66, 23, 54, -120, 17, -82, -69, 116, 44, -44, -41
};
```
